## drivers/video/b2r2/Kconfig
```kconfig
config FB_B2R2
	tristate "B2R2 engine support"
	default n
	help
	  B2R2 engine does various bit-blitting operations,post-processor operations
	  and various compositions.

config B2R2_PLUG_CONF
	bool "B2R2 bus plug configuration"
	depends on FB_B2R2
	default n
	help
	  Configures how B2R2 access the memory bus. Enabling this will increase
	  the performance of B2R2 at the cost of using the bus more heavily.

	  If this is set to 'n', the hardware defaults will be used.

choice
	prompt "Opcode size"
	depends on B2R2_PLUG_CONF
	default B2R2_OPSIZE_64

	config B2R2_OPSIZE_8
		bool "8 bytes"
	config B2R2_OPSIZE_16
		bool "16 bytes"
	config B2R2_OPSIZE_32
		bool "32 bytes"
	config B2R2_OPSIZE_64
		bool "64 bytes"

endchoice

choice
	prompt "Chunk size"
	depends on B2R2_PLUG_CONF
	default B2R2_CHSIZE_128

	config B2R2_CHSIZE_1
		bool "1 op"
	config B2R2_CHSIZE_2
		bool "2 ops"
	config B2R2_CHSIZE_4
		bool "4 ops"
	config B2R2_CHSIZE_8
		bool "8 ops"
	config B2R2_CHSIZE_16
		bool "16 ops"
	config B2R2_CHSIZE_32
		bool "32 ops"
	config B2R2_CHSIZE_64
		bool "64 ops"
	config B2R2_CHSIZE_128
		bool "128 ops"
endchoice

choice
	prompt "Message size"
	depends on B2R2_PLUG_CONF
	default B2R2_MGSIZE_128

	config B2R2_MGSIZE_1
		bool "1 chunk"
	config B2R2_MGSIZE_2
		bool "2 chunks"
	config B2R2_MGSIZE_4
		bool "4 chunks"
	config B2R2_MGSIZE_8
		bool "8 s"
	config B2R2_MGSIZE_16
		bool "16 chunks"
	config B2R2_MGSIZE_32
		bool "32 chunks"
	config B2R2_MGSIZE_64
		bool "64 chunks"
	config B2R2_MGSIZE_128
		bool "128 chunks"
endchoice

choice
	prompt "Page size"
	depends on B2R2_PLUG_CONF
	default B2R2_PGSIZE_256

	config B2R2_PGSIZE_64
		bool "64 bytes"
	config B2R2_PGSIZE_128
		bool "128 bytes"
	config B2R2_PGSIZE_256
		bool "256 bytes"
endchoice

config B2R2_DEBUG
	bool "B2R2 debugging"
	default n
	depends on FB_B2R2
	help
	  Enable debugging features for the B2R2 driver.

config B2R2_PROFILER
	tristate "B2R2 profiler"
	default n
	depends on FB_B2R2
	help
	  Enables the profiler for the B2R2 driver.

	  It is recommended to build this as a module, since the configuration
	  of filters etc. is done at load time.

config B2R2_GENERIC
	bool "B2R2 generic path"
	default y
	depends on FB_B2R2
	help
	  Enables support for the generic path in the B2R2 driver. This path should
	  be used when there is no optimized implementation for a request.

choice
	prompt "Generic usage mode"
	depends on B2R2_GENERIC
	default B2R2_GENERIC_FALLBACK

	config B2R2_GENERIC_FALLBACK
		bool "Fallback"
		help
		  The optimized path will be used for all supported operations, and the
		  generic path will be used as a fallback for the ones not implemented.

	config B2R2_GENERIC_ONLY
		bool "Always"
		help
		  The generic path will be used for all operations.

endchoice
```

## drivers/video/mcde/Kconfig
```kconfig
config MCDE
	bool

config FB_MCDE
	bool "MCDE fbdev support"
	depends on FB
	select FB_SYS_FILLRECT
	select FB_SYS_COPYAREA
	select FB_SYS_IMAGEBLIT
	select FB_SYS_FOPS
	select HWMEM
	select MCDE
	---help---
	  This enables support for MCDE based frame buffer driver.

	  Please read the file <file:Documentation/fb/mcde.txt>

config FB_MCDE_DEBUG
	bool "MCDE debug messages"
	depends on MCDE
	---help---
	  Say Y here if you want the MCDE driver to output debug messages

config FB_MCDE_VDEBUG
	bool "MCDE verbose debug messages"
	depends on FB_MCDE_DEBUG
	---help---
	  Say Y here if you want the MCDE driver to output more debug messages

config MCDE_FB_AVOID_REALLOC
	bool "MCDE early allocate framebuffer"
	default n
	depends on FB_MCDE
	---help---
	  If you say Y here maximum frame buffer size is allocated and
	  used for all resolutions. If you say N here, the frame buffer is
	  reallocated when resolution is changed. This reallocation might
	  fail because of fragmented memory. Note that this memory will
	  never be deallocated, while the MCDE framebuffer is used.

config MCDE_DISPLAY_DSI
	bool "Support for DSI displays within MCDE"
	depends on MCDE
	default y

menu "MCDE DSI displays"
	depends on MCDE_DISPLAY_DSI

config MCDE_DISPLAY_WS2401_DSI
	bool "Widechips WS2401 DSI display driver"

config MCDE_DISPLAY_KYLE_DSI
	bool "Novatec DSI display driver"

config MCDE_DISPLAY_SAMSUNG_S6D16D0
	bool "Samsung S6D16D0 DSI display driver"
	---help---
	  Say Y if you have a TPO Taal or Blackpearl display panel.

config MCDE_DISPLAY_S6E63M0_DSI
	bool "Samsung S6E63M0 DSI display driver"

config MCDE_DISPLAY_NT35512_DSI
	bool "Boe NT35512 DSI display driver"

config MCDE_DISPLAY_M1316A0_DSI
	bool "Samsung M1316A0 DSI display driver"

config MCDE_DISPLAY_TOSHIBA_DSI2LVDS
	bool "Toshiba DSI2LVDS display driver"
	---help---
	  Say Y if you have a DSI2LVDS bridge.

config MCDE_DISPLAY_HIMAX_HX8392
	bool "HIMAX_HX8392 display driver"
	---help---
	  Say Y if you have a chimei 990001267 display panel.
config MCDE_DISPLAY_NT35512_DSI
	bool "Boe NT35512 DSI display driver"

config MCDE_DISPLAY_SONY_ACX424AKP_DSI
	tristate "Sony acx424akp DSI display driver"

config MCDE_DISPLAY_AV8100
	tristate "AV8100 HDMI/CVBS display driver"
	select AV8100

config MCDE_DISPLAY_HDMI_FB_AUTO_CREATE
	bool "HDMI_FB_AUTO_CREATE"
	default y
	depends on MCDE_DISPLAY_AV8100
	---help---
	  Say Y if you want the HDMI frame buffer to be created on start
	  Say N if you want the HDMI frame buffer to be created when HDMI
	  cable is plugged (needs user space HDMIservice)

endmenu

config MCDE_DISPLAY_DPI
	bool "Support for DPI displays within MCDE"
	depends on MCDE
	default n
	---help---
	  Add this option to choose which DPI display driver for MCDE to include

	  DPI (Display Pixel Interface) is a MIPI Alliance standard used for
	  active-matrix LCDs. The DPI uses parallel data lines.

menu "MCDE DPI displays"
	depends on MCDE_DISPLAY_DPI

config MCDE_DISPLAY_VUIB500_DPI
	tristate "DPI display driver for the VUIB500 board"
	---help---
	  The VUIB500 is an ST-Ericsson user interface board.

config MCDE_DISPLAY_WS2401_DPI
         bool "DPI WS2401 display driver for Codina"
         select MCDE_DISPLAY_DPI_MAIN
         depends on FB_MCDE && SPI
         ---help---
           Say Y here if you want to use WS2401 LCD Panel.

config MCDE_DISPLAY_S6D27A1_DPI
         bool "DPI S6D27A1 display driver for Codina"
         select MCDE_DISPLAY_DPI_MAIN
         depends on FB_MCDE && SPI
         ---help---
           Say Y here if you want to use S6D27A1 LCD Panel.

config MCDE_DISPLAY_LD9040_DPI
         bool "DPI display driver for Keswick"
         select MCDE_DISPLAY_DPI_MAIN
         depends on FB_MCDE && SPI && BACKLIGHT_CLASS_DEVICE
         ---help---
           Say Y here if you want to use LCD Panel for Keswick board.

config MCDE_DISPLAY_S6E63MN0_DPI
         bool "DPI display driver for Archer Panel"
         select MCDE_DISPLAY_DPI_MAIN
         depends on FB_MCDE && SPI && BACKLIGHT_CLASS_DEVICE
         ---help---
           Say Y here if you want to use LCD Panel for Janice board.

config MCDE_DISPLAY_GAVINI_DPI
         bool "DPI display driver for Godin"
         select MCDE_DISPLAY_DPI_MAIN
         depends on FB_MCDE && SPI && BACKLIGHT_CLASS_DEVICE
         ---help---
           Say Y here if you want to use LCD Panel for Godin board.

config MCDE_DISPLAY_LMS397KF_DPI
         bool "DPI display driver for Godin"
         select MCDE_DISPLAY_DPI_MAIN
         depends on FB_MCDE && SPI && BACKLIGHT_CLASS_DEVICE
         ---help---
           Say Y here if you want to use LCD Panel for gavini board.

config MCDE_DISPLAY_I9060_DPI
         bool "DPI display driver for GT-I9060"
         select MCDE_DISPLAY_DPI_MAIN
         depends on FB_MCDE && SPI && BACKLIGHT_CLASS_DEVICE
         ---help---
           Say Y here if you want to use LCD Panel for GT-I9060 board.
endmenu
```

## sound/arm/Kconfig
```kconfig
# ALSA ARM drivers

menuconfig SND_ARM
	bool "ARM sound devices"
	depends on ARM
	default y
	help
	  Support for sound devices specific to ARM architectures.
	  Drivers that are implemented on ASoC can be found in
	  "ALSA for SoC audio support" section.

if SND_ARM

config SND_ARMAACI
	tristate "ARM PrimeCell PL041 AC Link support"
	depends on ARM_AMBA
	select SND_PCM
	select SND_AC97_CODEC

config SND_PXA2XX_PCM
	tristate
	select SND_PCM

config SND_PXA2XX_LIB
	tristate
	select SND_AC97_CODEC if SND_PXA2XX_LIB_AC97

config SND_PXA2XX_LIB_AC97
	bool

config SND_PXA2XX_AC97
	tristate "AC97 driver for the Intel PXA2xx chip"
	depends on ARCH_PXA
	select SND_PXA2XX_PCM
	select SND_AC97_CODEC
	select SND_PXA2XX_LIB
	select SND_PXA2XX_LIB_AC97
	help
	  Say Y or M if you want to support any AC97 codec attached to
	  the PXA2xx AC97 interface.

config SND_U8500_ALSA_AB8500
	tristate "U8500 alsa support for AB8500"
	depends on SND && STE_DMA40 && U8500_ACODEC && (U8500_AB8500_ED || U8500_AB8500_CUT10)
	default y
	select SND_PCM
	help
	  Say Y here if you have a u8500 based device
	  and want to use alsa for pcm playback and capture.

	  To compile this driver as a module, choose M here: the module
	  will be called u8500mod_alsa.

endif	# SND_ARM
```

## sound/soc/ux500/Kconfig
```kconfig
#
# Ux500 SoC audio configuration
#

menuconfig SND_SOC_UX500
	bool "SoC Audio support for Ux500 platform"
	depends on SND_SOC
	default n
	help
		Say Y if you want to add support for the Ux500 platform.

choice
	prompt "Platform 5500/8500"
	depends on SND_SOC_UX500
	default SND_SOC_U8500
	config SND_SOC_U8500
	bool "Platform - U8500"
	config SND_SOC_U5500
	bool "Platform - U5500"
endchoice

config SND_SOC_UX500_AB3550
	bool "Codec - AB3550"
	depends on SND_SOC_UX500 && (UX500_SOC_DB8500 || UX500_SOC_DB5500) && AB3550_CORE
	select SND_SOC_AB3550
	default n
	help
		Say Y if you want to include the AB3550 codec.

config SND_SOC_UX500_AB5500
	bool "Codec - AB5500"
	depends on SND_SOC_UX500 && (UX500_SOC_DB8500 || UX500_SOC_DB5500) && AB5500_CORE
	select SND_SOC_AB5500
	default n
	help
	        Say Y if you want to include the AB5500 codec.

config SND_SOC_UX500_AB8500
	bool "Codec - AB8500"
	depends on SND_SOC_UX500 && UX500_SOC_DB8500 && AB8500_CORE && AB8500_GPADC
	select SND_SOC_AB8500
	default n
	help
		Say Y if you want to include AB8500 audio codec.

config SND_SOC_UX500_CG29XX
	bool "Codec - CG29xx"
	depends on SND_SOC_UX500 && (UX500_SOC_DB8500 || UX500_SOC_DB5500) && CG2900_AUDIO
	select SND_SOC_CG29XX
	default n
	help
		Say Y if you want to include CG29xx codec (Combo chip).

config SND_SOC_UX500_AV8100
	bool "Codec - AV8100"
	depends on SND_SOC_UX500 && (UX500_SOC_DB8500 || UX500_SOC_DB5500) && AV8100
	select SND_SOC_AV8100
	default n
	help
		Say Y if you want to include AV8100 codec (HDMI chip).

config SND_SOC_UX500_DEBUG
	bool "Activate Ux500 platform debug-mode (pr_debug)"
	depends on SND_SOC_UX500
	default n
	help
		Say Y if you want to add debug level prints for Ux500 code-files.
```
