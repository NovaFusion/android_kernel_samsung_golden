## drivers/sensor/alps/Kconfig
```kconfig
#
# Sensors core device.
#
config SENSORS_ALPS
	bool "ALPS Sensor"
	default n
	help
	 This option enables alps sensors

config SENSORS_ALPS_CORE
	depends on SENSORS_ALPS
	tristate "sensors core for alps sensors"
	default n
	help
	  Say Y here to enable debugging messages for power supply class
	  and drivers.

config SENSORS_ACCEL
	depends on SENSORS_ALPS
	bool "Use ALPS framework for Accelerometer"
	default n
	help
	 This option enables accelerometer to use alps framework

config SENSORS_KXDM
	depends on I2C && SENSORS_ACCEL
	tristate "k2dm/k3dm STM accel"
	default n
	help
	  This option enables STM k2dm/k3dm accel driver

config SENSORS_HSCD
	depends on I2C && SENSORS_ALPS
	tristate "hscd alps mag"
	default n
	help
	  This option enables hscd alps mag driver

config SENSORS_GOLDEN
	depends on I2C && SENSORS_ALPS
	tristate "hscd alps mag"
	default n
	help
	  This option enables hscd alps mag driver
	  
config SENSORS_HSCDTD008A
	depends on I2C && SENSORS_ALPS
	tristate "hscd alps HSCDTD008A"
	default n
	help
	  This option enables hscd alps HSCDTD008A mag driver

config SENSORS_BMA254
	tristate "BMA254 Acceleration Sensor Driver"
	depends on I2C
	default n
	help
	  If you say yes here you get support for Bosch-Sensortec's
	  BMA254 Acceleration Sensor

config BMA254_SMART_ALERT
	tristate "BMA254 Acceleration Sensor Driver"
	depends on I2C
	default n
	help
	This option enables smart alert
```

## drivers/sensor/compass/Kconfig
```kconfig
#
# MAGNETIC Sensor Configuration
#

config COMPASS
	bool "MAGNETIC Sensor"
	default y
	help
	  This option enables magnetic sensors

config INPUT_YAS_MAGNETOMETER
	tristate "YAS Geomagnetic Sensor"
	depends on I2C
	
config INPUT_YAS_MAGNETOMETER_POSITION
	int "YAS Geomagnetic Sensor Mounting Position on Board"
	depends on INPUT_YAS_MAGNETOMETER
	default "0"
	help
	  Chip mounting position (pin 1).
	    0: top, upper-left
	    1: top, upper-right
	    2: top, lower-right
	    3: top, lower-left
	    4: bottom, upper-left
	    5: bottom, upper-right
	    6: bottom, lower-right
	    7: bottom, lower-left
		
```

## drivers/sensor/proximity/Kconfig
```kconfig
#
# MAGNETIC Sensor Configuration
#



config PROXIMITY                                                              
	bool "PROXIMITY Sensor"
	default n
	help
	This option enables proximity sensors  
	   

config PROXIMITY_CM3607
	depends on PROXIMITY
	tristate "Proximity sensor driver using CM3607"
	default n
	help
	  This option enables proximity sensor using cm3607.
	  

config PROXIMITY_GP2A
	depends on PROXIMITY
	tristate "Proximity sensor driver using GP2A"
	default n
	help
	  This option enables proximity sensor using GP2AP002S00F.

config LIGHT_PROX_GP2A
	depends on PROXIMITY
	tristate "Light and  Proximity sensor driver using GP2A"
	default n
	help
	  This option enables light and proximity sensor using GP2AP002S00F.

config GP2A_MODE_B
	depends on PROXIMITY
	tristate "Proximity sensor driver using GP2A mode B"
	default n
	help
	  This option enables MODE B in the proximity sensor GP2AP002S00F.

config PROXIMITY_TMD2672
	depends on PROXIMITY
	tristate "Proximity sensor driver using TMD2672"
	default n
	help
	  This option enables proximity sensor using TMD2672_P4.

config PROXIMITY_PX3215
	depends on PROXIMITY
	tristate "Proximity sensor driver using PX3215"
	default n
	help
	  This option enables proximity sensor using PX3215.

config PROXIMITY_PX3315
	depends on PROXIMITY
	tristate "Proximity sensor driver using PX3315"
	default n
	help
	  This option enables proximity sensor using PX3315.
```

## drivers/staging/android/Kconfig
```kconfig
menu "Android"

config ANDROID
	bool "Android Drivers"
	default N
	---help---
	  Enable support for various drivers needed on the Android platform

if ANDROID

config ANDROID_AB5500_TIMED_VIBRA
	bool "AB5500 Timed Output Vibrator"
	depends on AB5500_CORE
	depends on ANDROID_TIMED_OUTPUT
	default y
	help
	  Say Y here to enable linear/rotary vibrator driver using timed
	  output class device for ST-Ericsson's based on ST-Ericsson's
	  AB5500 Mix-Sig PMIC

config ANDROID_BINDER_IPC
	bool "Android Binder IPC Driver"
	default n

config ANDROID_LOGGER
	tristate "Android log driver"
	default n

config ANDROID_RAM_CONSOLE
	bool "Android RAM buffer console"
	default n

config ANDROID_RAM_CONSOLE_ENABLE_VERBOSE
	bool "Enable verbose console messages on Android RAM console"
	default y
	depends on ANDROID_RAM_CONSOLE

menuconfig ANDROID_RAM_CONSOLE_ERROR_CORRECTION
	bool "Android RAM Console Enable error correction"
	default n
	depends on ANDROID_RAM_CONSOLE
	depends on !ANDROID_RAM_CONSOLE_EARLY_INIT
	select REED_SOLOMON
	select REED_SOLOMON_ENC8
	select REED_SOLOMON_DEC8

if ANDROID_RAM_CONSOLE_ERROR_CORRECTION

config ANDROID_RAM_CONSOLE_ERROR_CORRECTION_DATA_SIZE
	int "Android RAM Console Data data size"
	default 128
	help
	  Must be a power of 2.

config ANDROID_RAM_CONSOLE_ERROR_CORRECTION_ECC_SIZE
	int "Android RAM Console ECC size"
	default 16

config ANDROID_RAM_CONSOLE_ERROR_CORRECTION_SYMBOL_SIZE
	int "Android RAM Console Symbol size"
	default 8

config ANDROID_RAM_CONSOLE_ERROR_CORRECTION_POLYNOMIAL
	hex "Android RAM Console Polynomial"
	default 0x19 if (ANDROID_RAM_CONSOLE_ERROR_CORRECTION_SYMBOL_SIZE = 4)
	default 0x29 if (ANDROID_RAM_CONSOLE_ERROR_CORRECTION_SYMBOL_SIZE = 5)
	default 0x61 if (ANDROID_RAM_CONSOLE_ERROR_CORRECTION_SYMBOL_SIZE = 6)
	default 0x89 if (ANDROID_RAM_CONSOLE_ERROR_CORRECTION_SYMBOL_SIZE = 7)
	default 0x11d if (ANDROID_RAM_CONSOLE_ERROR_CORRECTION_SYMBOL_SIZE = 8)

endif # ANDROID_RAM_CONSOLE_ERROR_CORRECTION

config ANDROID_RAM_CONSOLE_EARLY_INIT
	bool "Start Android RAM console early"
	default n
	depends on ANDROID_RAM_CONSOLE

config ANDROID_RAM_CONSOLE_EARLY_ADDR
	hex "Android RAM console virtual address"
	default 0
	depends on ANDROID_RAM_CONSOLE_EARLY_INIT

config ANDROID_RAM_CONSOLE_EARLY_SIZE
	hex "Android RAM console buffer size"
	default 0
	depends on ANDROID_RAM_CONSOLE_EARLY_INIT

config ANDROID_TIMED_OUTPUT
	bool "Timed output class driver"
	default y

config ANDROID_TIMED_GPIO
	tristate "Android timed gpio driver"
	depends on GENERIC_GPIO && ANDROID_TIMED_OUTPUT
	default n

config ANDROID_LOW_MEMORY_KILLER
	bool "Android Low Memory Killer"
	default N
	---help---
	  Register processes to be killed when memory is low

config ANDROID_STE_TIMED_VIBRA
	bool "ST-Ericsson Timed Output Vibrator"
	depends on SND_SOC_AB8500
	depends on ANDROID_TIMED_OUTPUT
	default y
	help
	  ST-Ericsson's vibrator driver using timed output class device

endif # if ANDROID

endmenu
```

## drivers/staging/camera_flash/Kconfig
```kconfig
config U8500_FLASH
	bool "ST-Ericsson Flash (Camera) Driver"
	depends on ARCH_U8500
	help
	  Adds ST-Ericsson Flash (Camera) Driver
```

## drivers/staging/cg2900/Kconfig
```kconfig
#
# CG2900
#

config CG2900
	tristate "Support ST-Ericsson CG2900 main structure"
	depends on NET && MFD_SUPPORT
	help
	  ST-Ericsson CG2900 Connectivity Combo controller main
	  structure.
	  Supports multiple functionalities muxed over a Bluetooth HCI H:4
	  interface.
	  CG2900 support Bluetooth, FM radio, and GPS.

config CG2900_CHIP
	tristate "Support CG2900 Connectivity controller"
	depends on CG2900
	help
	  ST-Ericsson CG2900 Connectivity Controller chip handler.
	  Contains chip handler performing driver initialization
	  such as patchdownload and also instantiates the supported
	  MFD devices.

config STLC2690_CHIP
	tristate "Support STLC2690 Connectivity controller"
	depends on CG2900
	help
	  ST-Ericsson STLC2690 Connectivity Controller chip handler.
	  Contains chip handler performing driver initialization
	  such as patchdownload and also instantiates the supported
	  MFD devices.

config CG2900_UART
	tristate "Support CG2900 UART transport"
	depends on CG2900
	select BT
	select BT_HCIUART
	help
	  UART driver for ST-Ericsson CG2900 Connectivity Controller.
	  Contains functions for setting baud rate and to transport
	  data to and from the CG2900 controller over UART.
	  Also handles low power handling for the CG2900 when using UART as
	  transport.

config CG2900_AUDIO
	tristate "Support CG2900 audio interface"
	depends on CG2900
	help
	  ST-Ericsson CG2900 Connectivity audio interface driver.
	  Gives a module the ability to setup audio paths
	  within the CG2900 controller.
	  Supports both a normal function API and using character device
	  from user space.

config CG2900_TEST
	tristate "Support CG2900 Test Char Device"
	depends on CG2900
	help
	  ST-Ericsson CG2900 Test Character Device driver.
	  Creates a character device which can be used by
	  a test framework in user space to emulate a connected chip.
	  Note that this is used to test the chip handler driver,
	  not to test the connected chip.

config BT_CG2900
	tristate "ST-Ericsson CG2900 Bluetooth driver"
	depends on CG2900 && BT
	help
	  Select if ST-Ericsson CG2900 Connectivity controller shall be used as
	  Bluetooth controller for BlueZ.
	  This driver registers to the Bluetooth stack and when opened,
	  enables the CG2900 controller in a proper way.
```

## drivers/staging/cw1200/Kconfig
```kconfig
config CW1200
       tristate "CW1200 WLAN support"
       select MAC80211
       select CFG80211
       help

         This is an experimental driver for the cw1200 chip-set.
         Enabling this option enables the generic driver without
         any platform support.

         Please select the appropriate platform below.

if CW1200

config CW1200_NON_POWER_OF_TWO_BLOCKSIZES
      bool "Platform supports non-power-of-two SDIO transfer"
      depends on CW1200
      help
        Say N here only if you are running the driver on a platform
        which does not have support for non-power-of-two SDIO transfer.
        If unsure, say Y.

config CW1200_USE_GPIO_IRQ
      bool "Use GPIO interrupt"
      depends on CW1200
      help
        Say Y here if you want to include GPIO IRQ support instead of SDIO IRQ.
        If unsure, say N.

config CW1200_FIRMWARE_DOES_NOT_SUPPORT_KEEPALIVE
      bool "Software keep-alive (DEVELOPMENT)"
      depends on CW1200
      help
        Say Y if your firmware does not support keep-alive functionality
        or you suspect problems with the implementation.
        Please finalize software the software keep-alive functionality in
        that case.
        If unsure, say N.

config CW1200_5GHZ_SUPPORT
      bool "5GHz band support"
      depends on CW1200
      help
        Say Y if your device supports 5GHz band. Should be disabled for
        CW1100 silicon.
        If unsure, say N.

menu "Driver debug features"
      depends on CW1200

config CW1200_DEBUGFS
      bool "Expose driver internals to DebugFS (DEVELOPMENT)"

config CW1200_BH_DEBUG
      bool "Enable low-level device communication logs (DEVELOPMENT)"

config CW1200_WSM_DEBUG
      bool "Enable WSM API debug messages (DEVELOPMENT)"

config CW1200_WSM_DUMPS
      bool "Verbose WSM API logging (DEVELOPMENT)"

config CW1200_TXRX_DEBUG
      bool "Enable TX/RX debug messages (DEVELOPMENT)"

config CW1200_TX_POLICY_DEBUG
      bool "Enable TX policy debug (DEVELOPMENT)"

config CW1200_STA_DEBUG
      bool "Enable STA/AP debug (DEVELOPMENT)"

endmenu

endif
```

## drivers/staging/mmio/Kconfig
```kconfig
config U8500_MMIO
	bool "ST-Ericsson MMIO (Camera) Driver"
	depends on ARCH_U8500
	help
	  Enables the ST-Ericsson MMIO (Camera) Driver

config U5500_MMIO
	bool "ST-Ericsson U5500 MMIO (Camera) Driver"
	depends on UX500_SOC_DB5500
```

## drivers/staging/nmf-cm/Kconfig
```kconfig
config U8500_CM
	tristate "Ux500 Component Manager driver"
	depends on UX500_SOC_DB8500 && HWMEM
	help
	  This is the Component Manager driver. It is part of the
	  Nomadik Multiprocessing Framework.

	  Note: This option allows the kernel developers to build
	  the driver in kernel to ease there life. By default, this driver
	  must be built outside this kernel source tree.
```

## drivers/staging/pasr/Kconfig
```kconfig
config ARCH_HAS_PASR
	bool

config PASR
	bool "DDR Partial Array Self-Refresh"
	depends on ARCH_HAS_PASR
	---help---
	  PASR Frameworks brings support for the Partial Array Self-Refresh DDR
	  power management feature. PASR has been introduced in LP-DDR2, and is
	  also present in DDR3.
	  The role of this framework is to stop the refresh of unused memory to
	  enhance DDR power consumption.

config PASR_DEBUG
	bool "Add PASR debug prints"
	def_bool n
	depends on PASR

config UX500_PASR
	bool "Ux500 Family PASR driver"
	def_bool y
	depends on (PASR && UX500_SOC_DB8500)
```

## drivers/tee/Kconfig
```kconfig
#
# Copyright (C) ST-Ericsson SA 2010
# Author: Martin Hovang (martin.xm.hovang@stericsson.com)
# License terms: GNU General Public License (GPL) version 2
#

# Trursted Execution Environment Configuration
config TEE_SUPPORT
	bool "Trusted Execution Environment Support"
	default y
	---help---
	  This implements the Trusted Execution Environment (TEE) Client
	  API Specification from GlobalPlatform Device Technology.
```

## drivers/video/av8100/Kconfig
```kconfig
config AV8100
       tristate "AV8100 driver support(HDMI/CVBS)"
       default n
       help
           Please enable this feature if hdmi/tvout driver support is required.

config HDMI_AV8100_DEBUG
	bool "HDMI and AV8100 debug messages"
	default n
	depends on AV8100
	---help---
	  Say Y here if you want the HDMI and AV8100 driver to
	  output debug messages.

choice
	prompt "AV8100 HW trig method"
	default AV8100_HWTRIG_DSI_TE

config AV8100_HWTRIG_INT
	bool "AV8100 HW trig on INT"
	depends on AV8100
	---help---
	  If you say Y here AV8100 will use HW triggering
	  from AV8100 INT to MCDE sync0.

config AV8100_HWTRIG_I2SDAT3
	bool "AV8100 HW trig on I2SDAT3"
	depends on AV8100
	---help---
	  If you say Y here AV8100 will use HW triggering
	  from AV8100 I2SDAT3 to MCDE sync1.

config AV8100_HWTRIG_DSI_TE
	bool "AV8100 HW trig on DSI"
	depends on AV8100
	---help---
	  If you say Y here AV8100 will use HW triggering
	  using DSI TE polling between AV8100 and MCDE.

config AV8100_HWTRIG_NONE
	bool "AV8100 SW trig"
	depends on AV8100
	---help---
	  If you say Y here AV8100 will use SW triggering
	  between AV8100 and MCDE.

endchoice
```
