## arch/arm/mach-ux500/test/Kconfig
```kconfig
config DB8500_PWR_TEST
	bool "Power usage module test"
	depends on (UX500_SOC_DB8500 && DEBUG_FS && REGULATOR_AB8500_DEBUG && UX500_SUSPEND_DBG)
	help
	  Add power module tests for idle and suspend
```

## drivers/char/hwreg/Kconfig
```kconfig
config HWREG
	tristate "HWREG support"
	default m
	help
	  If you say Y here, the support for HWREG will be compiled into the kernel
	  and accessible via /dev/hwreg. You can also say M here and the driver will
	  be build as a module named hwreg.ko.

	  If unsure, say N.
```

## drivers/clocksource/Kconfig
```kconfig
config CLKSRC_I8253
	bool

config CLKSRC_MMIO
	bool

config CLKSRC_DBX500_PRCMU
	bool "Clocksource PRCMU Timer"
	depends on UX500_SOC_DB5500 || UX500_SOC_DB8500
	default y if UX500_SOC_DB8500
	help
	  Use the always on PRCMU Timer as clocksource

config CLKSRC_DBX500_PRCMU_SCHED_CLOCK
	bool
	depends on CLKSRC_DBX500_PRCMU
	select HAVE_SCHED_CLOCK
	help
	  Use the always on PRCMU Timer as sched_clock

config CLKSRC_DB5500_MTIMER
	bool "Clocksource MTIMER"
	depends on UX500_SOC_DB5500
	default y
	help
	  Use the always on MTIMER as clocksource

config CLKSRC_DB5500_MTIMER_SCHED_CLOCK
	bool
	depends on CLKSRC_DB5500_MTIMER
	select HAVE_SCHED_CLOCK
	help
	  Use the always on PRCMU Timer as sched_clock
```

## drivers/cpuidle/Kconfig
```kconfig
config CPU_IDLE
	bool "CPU idle PM support"
	default ACPI
	depends on PM
	help
	  CPU idle is a generic framework for supporting software-controlled
	  idle processor power management.  It includes modular cross-platform
	  governors that can be swapped during runtime.

	  If you're using an ACPI-enabled platform, you should say Y here.

config CPU_IDLE_GOV_LADDER
	bool
	depends on CPU_IDLE
	default y

config CPU_IDLE_GOV_MENU
	bool
	depends on CPU_IDLE && NO_HZ
	default y

config DBX500_CPUIDLE
	bool "DBX500 CPUIdle support"
	depends on CPU_IDLE && (MFD_DB5500_PRCMU || MFD_DB8500_PRCMU || MFD_DBX540_PRCMU) && PM
	default y
	select GENERIC_CLOCKEVENTS_BROADCAST
	select DBX500_CONTEXT
	help
	  Add support for CPUIdle for U8500.

config DBX500_CPUIDLE_DEEPEST_STATE
	int "DBX500 Deepest sleep state"
	default 4 if UX500_SOC_DB8500
	default 1 if UX500_SOC_DB5500
	depends on DBX500_CPUIDLE
	help
	  Set deepest sleep state. See the cstate struct in cpuidle-dbx500.c.
	  Default is ApSleep.

config DBX500_CPUIDLE_APDEEPIDLE
	bool "DBX500 CPUIdle ApDeepIdle"
	depends on DBX500_CPUIDLE
	help
	  Adds the power level ApDeepIdle, where APE is powered on while
	  ARM is powered off. Default n. Not supported on DB8500.

config DBX500_CPUIDLE_DEBUG
	bool "DBX500 CPUIdle debug"
	depends on DBX500_CPUIDLE && DEBUG_FS
	help
	  Add debugging support for CPUIdle for DBX500.
```

## drivers/crypto/ux500/Kconfig
```kconfig
#
# Copyright (C) ST-Ericsson SA 2010
# Author: Shujuan Chen (shujuan.chen@stericsson.com)
# License terms: GNU General Public License (GPL) version 2
#

config CRYPTO_DEV_UX500_CRYP
	tristate "UX500 crypto driver for CRYP block"
	depends on CRYPTO_DEV_UX500
	select CRYPTO_DES
	help
	  This is the driver for the crypto block CRYP.

config CRYPTO_DEV_UX500_HASH
	tristate "UX500 crypto driver for HASH block"
	depends on CRYPTO_DEV_UX500
	select CRYPTO_HASH
	select CRYPTO_HMAC
	help
	  This selects the UX500 hash driver for the HASH hardware.
	  Depends on U8500/STM DMA if running in DMA mode.

config CRYPTO_DEV_UX500_DEBUG
	bool "Activate ux500 platform debug-mode for crypto and hash block"
	depends on CRYPTO_DEV_UX500_CRYP || CRYPTO_DEV_UX500_HASH
	default n
	help
	  Say Y if you want to add debug prints to ux500_hash and
	  ux500_cryp devices.
```

## drivers/gpu/drm/nova/Kconfig
```kconfig
config DRM_NOVA
	bool "Nova MCDE DRM/KMS support"
	depends on DRM && PLAT_NOMADIK
	select DRM_KMS_HELPER
	select FB_SYS_FILLRECT
	select FB_SYS_COPYAREA
	select FB_SYS_IMAGEBLIT
	select FB_SYS_FOPS
	select MCDE
	help
	  Choose this option to enable KMS display driver support for
	  u5500/u8500/u9540 SoCs.
```

## drivers/hsi/controllers/Kconfig
```kconfig
#
# HSI controllers configuration
#
comment "HSI controllers"

config STE_HSI
       tristate "STE HSI controller driver"
       depends on (ARCH_U8500 || ARCH_NOMADIK) && HSI
       default n
       help
         ST-Ericsson HSI controller.
         If you say Y here, you will enable the U8500 HSI hardware driver.

         If unsure, say N.

config OMAP_SSI
	tristate "OMAP SSI hardware driver"
	depends on ARCH_OMAP && HSI
	default n
	---help---
	  SSI is a legacy version of HSI. It is usually used to connect
	  an application engine with a cellular modem.
	  If you say Y here, you will enable the OMAP SSI hardware driver.

	  If unsure, say N.

if OMAP_SSI

config OMAP_SSI_CONFIG
	boolean
	default y

endif # OMAP_SSI
```

## drivers/misc/modem_audio/Kconfig
```kconfig
config MODEM_AUDIO_DRIVER
	bool "Modem Audio Driver"
	depends on (U5500_MBOX && UX500_SOC_DB5500)
	help
	  This module is used for read and write data between APE and
	  Access side in u5500  platform.
```

## drivers/misc/tspdrv/Kconfig
```kconfig
#
# Immersion TouchSense Player driver configuration
#
config IMMERSION_TSPDRV
	tristate "Immersion TouchSense Player driver for Haptics"
	default n
	help
	This option enables Immersion TouchSense driver for Haptics interface
	select Y to build it into the kernel
	select N to disable it
```

## drivers/modem/Kconfig
```kconfig
config MODEM
        bool "Modem Access Framework"
        default y
        help
         Add support for Modem Access Framework. It allows different
	 platform specific drivers to register modem access mechanisms
	 and allows transparent access to modem to the client drivers.

	 If unsure, say N.

config MODEM_U5500_MCDD
	tristate "Modem crash dump detection driver for STE U5500 platform"
	depends on (UX500_SOC_DB5500 && U5500_MODEM_IRQ && MODEM)
	default y
	help
	 Add support for Modem crash detection
	 driver for  STE U5500 platform.
	 And inform userspace.

         If unsure, say N.

config MODEM_U8500
	bool "Modem Access driver for STE U8500 platform"
	depends on MODEM
	default n
	help
	 Add support for Modem Access driver on STE U8500 platform which
	 uses Shared Memroy as IPC mechanism between Modem processor and
	 Application processor.

	 If unsure, say N.

source "drivers/modem/shrm/Kconfig"

config MODEM_M6718
	tristate "Modem Access driver for STE M6718 modem"
	depends on MODEM
	default n
	help
	 Add support for the modem access driver for the M6718 modem.

	 If unsure, say N.

source "drivers/modem/m6718_spi/Kconfig"

config U8500_KERNEL_CLIENT
	bool "U8500 kenrel client"
	depends on U8500_SHRM && UX500_SOC_DB8500
	default n
	help
	  This is the kernel client driver, responsible of receiving,
	  manupilating and sending response to and from modem.
	  If unsure, say N.
```

## drivers/modem/m6718_spi/Kconfig
```kconfig
#
# M6718 modem SPI IPC driver kernel configuration
#
config MODEM_M6718_SPI
	tristate "M6718 modem IPC SPI driver"
	depends on MODEM_M6718
	default y
	---help---
	  If you say Y here, you will enable the M6718 modem IPC SPI driver.

	  If unsure, say Y.

config MODEM_M6718_SPI_DEBUG
	boolean "Modem driver debug"
	depends on MODEM_M6718_SPI
	default N
	---help---
	   If you say Y here, you will enable full debug trace from the M6718
	   modem driver.  This should not be enabled by default.

	   If unsure, say N.

config MODEM_M6718_SPI_ENABLE_FEATURE_MODEM_STATE
	boolean "M6718 modem state driver integration"
	depends on MODEM_M6718_SPI
	default y
	---help---
	  Enables integration of the IPC driver with the modem state driver.
	  This allows the IPC driver to be notified of changes in modem state
	  (on, off, reset) and allows the IPC driver to cause modem state
	  changes if needed.

	  By default this should be enabled.

config MODEM_M6718_SPI_ENABLE_FEATURE_FRAME_DUMP
	boolean "IPC SPI L1 frame dump"
	depends on MODEM_M6718_SPI
	default n
	---help---
	  If you say Y here, you will enable dumping of the raw TX and RX frames
	  by the IPC driver L1.

	  If unsure, say N.

config MODEM_M6718_SPI_ENABLE_FEATURE_LOOPBACK
	boolean "Modem IPC loopback support"
	depends on MODEM_M6718_SPI
	default y
	---help---
	  If you say Y here, you will enable the IPC loopback channels/devices.

	  If unsure, say Y.


config MODEM_M6718_SPI_ENABLE_FEATURE_VERIFY_FRAMES
	boolean "Verify loopback frames"
	depends on MODEM_M6718_SPI
	default n
	---help---
	  This will enabling checking of loopback frames to verify that the data
	  received is identical to the data sent.

	  If unsure, say N.

config MODEM_M6718_SPI_ENABLE_FEATURE_THROUGHPUT_MEASUREMENT
	boolean "Modem IPC throughput measurement"
	depends on MODEM_M6718_SPI
	default n
	---help---
	  If you say Y here, you will enable the IPC link throughput
	  measurement and reporting.

	  If unsure, say N.

config MODEM_M6718_SPI_SET_THROUGHPUT_FREQUENCY
	int "Sample rate for throughput measurements (seconds)"
	default "5"
	depends on MODEM_M6718_SPI_ENABLE_FEATURE_THROUGHPUT_MEASUREMENT
	help
	  The sample frequency for taking IPC SPI link throughput measurements.
	  Increasing the rate (reducing the time) will increase the accuracy of
	  the measurements, but will also increase the impact on link and system
	  performance.
```

## drivers/modem/shrm/Kconfig
```kconfig
#
# SHM HW kernel configuration
#
config U8500_SHRM
	bool "U8500 SHRM hardware driver"
	depends on ARCH_U8500 && PHONET && MODEM_U8500
	default Y
	---help---
	  If you say Y here, you will enable the STN8500 SHM hardware driver.

	  If unsure, say N.
choice
	prompt "Modem Image Version"
	depends on U8500_SHRM
	default SHRM_V1_UPDATES_VERSION

	config SHRM_ED_V1_VERSION
	depends on U8500_SHRM
	bool "SHRM ED / V1 "
	help
	 Modem Images with ED/V1 updates

	config SHRM_V1_UPDATES_VERSION
	depends on U8500_SHRM
	bool "SHRM V1 UPDATES"
	help
	 Modem Images with V1 Updates

endchoice

choice
	prompt "SHRM Network Interface"
	depends on U8500_SHRM
	default U8500_SHRM_DEFAULT

	config U8500_SHRM_DEFAULT_NET
	depends on U8500_SHRM
	bool "Default shrm0 network interface"
	help
	 The default shrm0 network interface

	config U8500_SHRM_SVNET
	depends on U8500_SHRM
	bool "svnet0 network interface"
	help
	 The svnet0 network interface

endchoice

config U8500_SHRM_LOOP_BACK
	bool "U8500 SHRM loopback"
	depends on U8500_SHRM
	default n
	---help---
	  If you say Y here, you will enable the shm loopback

	  If unsure, say N.

config U8500_SHRM_MODEM_SILENT_RESET
	bool "U8500 SHRM Modem Silent Reset"
	depends on U8500_SHRM
	default n
	---help---
	  If you say Y here, you will enable the modem silent reset feature

	  If unsure, say N.

config U8500_SHRM_ENABLE_FEATURE_SIGNATURE_VERIFICATION
	bool "U8500 SHRM Signature Verifiaction"
	depends on U8500_SHRM
	default y
	---help---
	  If you say Y here, you will enable the shm signature verification

	  If unsure, say N.
```

## drivers/phone_svn/Kconfig
```kconfig
#
#
#

menuconfig SAMSUNG_PHONE_SVNET
	tristate "Samsung Phone Interface - SVN"
	default n
	---help---
		I love you.

if SAMSUNG_PHONE_SVNET

menuconfig PHONE_MODEMCTL 
	tristate "Modem Control"
	depends on SAMSUNG_PHONE_SVNET
	default m
	help
	  Say Y to enable Modem Control support.

menuconfig PHONE_ONEDRAM
	tristate "OneDRAM"
	depends on SAMSUNG_PHONE_SVNET
	default m
	help
	  Say Y to enable OneDRAM Interface support.

menuconfig PHONE_SVNET
	tristate "Samsung Virtual Network"
	depends on SAMSUNG_PHONE_SVNET
	default m
	help
	  Say Y to enable Samsung Virtual Network support

config SVNET_WHITELIST
	bool "svnet uses whitelist via onedram"
	default n
	---help---
	  By default, n

	  When in doubt, say N.


endif # SAMSUNG_PHONE_SVNET
```

## drivers/phone_svn/onedram/Kconfig
```kconfig
#
# OneDRAM configuration
#
config DPRAM_BUILT_IN
	tristate "onedram driver built-in"

	---help---
	  By default, n

	  When in doubt, say N.

config SVNET_WHITELIST
	bool "svnet uses whitelist via onedram"
	default n
	---help---
	  By default, n

	  When in doubt, say N.
```

## drivers/samsung/Kconfig
```kconfig
#
#
#

menu "Samsung Kernel Modules"

config SAMSUNG_MODULES
	tristate "Samsung Kernel Modules"
	default m
	help
	  Say Y to enable Samsung kernel modules. j4fs and param
	  modules are included.

config J4FS
	tristate "Samsung J4FS support"
	depends on SAMSUNG_MODULES
	default m
	help
	  Say Y to enable Samsung J4FS support.

config SAMSUNG_PARAM
	tristate "Samsung Param-Partition Support"
	depends on SAMSUNG_MODULES
	default m
	help
		Say Y to enable Samsung Param support.


source "drivers/samsung/startup_reason/Kconfig"

endmenu
```

## drivers/samsung/startup_reason/Kconfig
```kconfig
config STARTUP_REASON 
	bool "Startup reason"
	default n
	help
	  Say Y here to enable startup class support. 

config AB8500_STARTUP_REASON
	depends on STARTUP_REASON
	bool "Enables startup reason support for ab8500 chipset "
	help
	  Enables startup reason support for ab8500 chipset
```

## drivers/sensor/Kconfig
```kconfig
menuconfig NEW_SENSORS
	bool "Sensors Support"
	help
	  Say Y to enable Sensors support.  This allows control of supported
	  Sensors.

if NEW_SENSORS

source "drivers/sensor/alps/Kconfig"
source "drivers/sensor/proximity/Kconfig"
source "drivers/sensor/orientation/Kconfig"
source "drivers/sensor/mpu3050/Kconfig"
source "drivers/sensor/compass/Kconfig"

endif # NEW_SENSORS
```

## drivers/sensor/accelerometer/Kconfig
```kconfig
#
# Copyright (c) 2010 Yamaha Corporation
#
# This program is free software; you can redistribute it and/or
# modify it under the terms of the GNU General Public License
# as published by the Free Software Foundation; either version 2
# of the License, or (at your option) any later version.
#
# This program is distributed in the hope that it will be useful,
# but WITHOUT ANY WARRANTY; without even the implied warranty of
# MERCHANTABILITY or FITNESS FOR A PARTICULAR PURPOSE.  See the
# GNU General Public License for more details.
#
# You should have received a copy of the GNU General Public License
# along with this program; if not, write to the Free Software
# Foundation, Inc., 51 Franklin Street, Fifth Floor, Boston, MA  02110-1301,
# USA.
#

config INPUT_YAS_ACCELEROMETER
         tristate "YAS Acceleration Sensor"
         depends on I2C

config SENSORS_YAS_KXDM
	depends on INPUT_YAS_ACCELEROMETER
	tristate "k2dm/k3dm STM accel"
	default n
	help
	  This option enables STM k2dm/k3dm accel driver

config INPUT_YAS_ACCELEROMETER_POSITION
         int "YAS Acceleration Sensor Mounting Position on Board"
         depends on INPUT_YAS_ACCELEROMETER
         default "0"
         help
           Chip mounting position (pin 1).
              0: top, upper-left
              1: top, upper-right
              2: top, lower-right
              3: top, lower-left
              4: bottom, upper-left
              5: bottom, upper-right
              6: bottom, lower-right
              7: bottom, lower-left
```
